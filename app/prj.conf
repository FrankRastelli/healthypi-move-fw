## CMakeLists.txt
```
# SPDX-License-Identifier: Apache-2.0

cmake_minimum_required(VERSION 3.20.0)

macro(app_set_runner_args)
  if(CONFIG_BOARD_HEALTHYPI_MOVE_NRF5340_CPUAPP)
    # Use alternative QSPI configuration file 
    board_runner_args(nrfjprog "--qspiini=${CMAKE_CURRENT_SOURCE_DIR}/qspi_w25.ini")
  endif()
endmacro()

find_package(Zephyr REQUIRED HINTS $ENV{ZEPHYR_BASE})

project(healthypi_move)

FILE(GLOB app_sources CONFIGURE_DEPENDS
                        src/*.c
                        src/images/*.c
                        src/ui/*.c
                        src/ui/components/*.c
                        src/ui/images/*.c
                        src/ui/fonts/*.c
                        src/ui/fonts/lvgl/*.c
                        src/ui/screens/*.c
                        src/sm/*.c)  

# Exclude TODAY screen source if disabled
if(NOT CONFIG_HPI_TODAY_SCREEN)
  list(FILTER app_sources EXCLUDE REGEX ".*/src/ui/screens/scr_today\\.c$")
endif()

# Exclude GSR sources if the screen is disabled
if(NOT CONFIG_HPI_GSR_SCREEN)
  list(FILTER app_sources EXCLUDE REGEX ".*/src/ui/screens/scr_gsr\\.c$")
  list(FILTER app_sources EXCLUDE REGEX ".*/src/ui/screens/scr_gsr_plot\\.c$")
endif()

target_sources(app PRIVATE ${app_sources})

# Explicitly include autoscale helper (ensure CMake picks it up if globbing was run earlier)
target_sources(app PRIVATE src/ui/hpi_ppg_autoscale.c)

# Explicitly include measurement settings (ensure CMake picks it up if globbing was run earlier)
target_sources(app PRIVATE src/hpi_measurement_settings.c)

if(CONFIG_MAX32664_UPDATER)
    FILE(GLOB max32664_updater_sources 
         src/max32664_updater/max32664_updater.c)
    target_sources(app PRIVATE ${max32664_updater_sources})
    zephyr_library_include_directories(${CMAKE_CURRENT_SOURCE_DIR}/src/max32664_updater)
endif()

zephyr_library_include_directories(${CMAKE_CURRENT_SOURCE_DIR}/drivers)
zephyr_library_include_directories(${CMAKE_CURRENT_SOURCE_DIR}/include)
zephyr_library_include_directories(${CMAKE_CURRENT_SOURCE_DIR}/src)

set(gen_dir ${ZEPHYR_BINARY_DIR}/include/generated/)

# This places images in the external flash memory

#zephyr_code_relocate(FILES lib/max32664_updater/max32664_updater.c LOCATION EXTFLASH_TEXT NOCOPY)
#zephyr_code_relocate(FILES lib/max32664_updater/msbl/max32664c_30_13_31.c LOCATION EXTFLASH_RODATA NOCOPY)
#zephyr_code_relocate(FILES lib/max32664_updater/msbl/max32664d_40_6_0.c LOCATION EXTFLASH_RODATA NOCOPY)

#zephyr_code_relocate(LIBRARY subsys__mgmt__mcumgr__mgmt LOCATION EXTFLASH_TEXT NOCOPY)
#zephyr_code_relocate(LIBRARY subsys__mgmt__mcumgr__transport LOCATION EXTFLASH_TEXT NOCOPY)
#zephyr_code_relocate(LIBRARY subsys__mgmt__mcumgr__util LOCATION EXTFLASH_TEXT NOCOPY)
#zephyr_code_relocate(LIBRARY subsys__mgmt__mcumgr__smp LOCATION EXTFLASH_TEXT NOCOPY)
#zephyr_code_relocate(LIBRARY subsys__mgmt__mcumgr__grp__img_mgmt LOCATION EXTFLASH_TEXT NOCOPY)
#zephyr_code_relocate(LIBRARY subsys__mgmt__mcumgr__grp__os_mgmt LOCATION EXTFLASH_TEXT NOCOPY)

#zephyr_code_relocate(LIBRARY modules__cmsis-dsp LOCATION EXTFLASH_TEXT NOCOPY)
```

## prj.conf
```kconfig
# HealthyPi Move specific configurations
CONFIG_HPI_TODAY_SCREEN=n
CONFIG_HPI_GSR_SCREEN=y
CONFIG_HPI_GSR_STRESS_INDEX=y

CONFIG_BT=y
CONFIG_BT_PERIPHERAL=y
CONFIG_BT_CENTRAL=y
CONFIG_BT_OBSERVER=y
CONFIG_BT_GATT_CLIENT=y
CONFIG_BT_MAX_CONN=2
CONFIG_BT_BAS=y
CONFIG_BT_HRS=y
CONFIG_BT_DEVICE_NAME="healthypi move"
CONFIG_BT_DEVICE_APPEARANCE=833

CONFIG_BT_RX_STACK_SIZE=4096

CONFIG_BT_DIS=y
CONFIG_BT_DIS_PNP=n
CONFIG_BT_DIS_FW_REV=y
CONFIG_BT_DIS_MANUF="Protocentral"
CONFIG_BT_DIS_MODEL="Move"
#CONFIG_BT_DIS_SETTINGS=y
#CONFIG_BT_DIS_STR_MAX=100

# Reduced Bluetooth data packets for flash optimization
CONFIG_BT_L2CAP_TX_MTU=247
CONFIG_BT_BUF_ACL_RX_SIZE=251
CONFIG_BT_BUF_ACL_TX_SIZE=251
CONFIG_BT_CTLR_DATA_LENGTH_MAX=251

# Memory Configuration - Restored for debugging
CONFIG_HEAP_MEM_POOL_SIZE=22528        
CONFIG_SYSTEM_WORKQUEUE_STACK_SIZE=24576 
CONFIG_MAIN_STACK_SIZE=16384           

# CONFIG_PM_OVERRIDE_EXTERNAL_DRIVER_CHECK=y

# Zephyr OS Configuration - Debug enabled
CONFIG_SMF=y
CONFIG_EVENTS=y
CONFIG_CBPRINTF_FP_SUPPORT=y

# Enable debugging features for development
CONFIG_ASSERT=y
CONFIG_DEBUG_INFO=y
CONFIG_DEBUG_THREAD_INFO=y
CONFIG_THREAD_NAME=y
CONFIG_THREAD_STACK_INFO=y

# Size optimization disabled for debugging
#CONFIG_SIZE_OPTIMIZATIONS=y
#CONFIG_COMPILER_OPT="-Os"

# Peripheral device drivers
CONFIG_SENSOR=y
CONFIG_SENSOR_INFO=y
CONFIG_SENSOR_MAX30001=y
CONFIG_SENSOR_MAX32664D=y
CONFIG_SENSOR_MAX30208=y
#CONFIG_SENSOR_MAXM86146=y
CONFIG_SENSOR_MAX32664C=y
CONFIG_SENSOR_ASYNC_API=y

CONFIG_REGULATOR=y
CONFIG_ADC=n

CONFIG_SENSOR_BMI323_HPI=y
CONFIG_RTC=y
CONFIG_RTC_RV8263=y

CONFIG_INPUT=y
CONFIG_INPUT_CHSC5816=y

CONFIG_I2C=y
CONFIG_I2C_NRFX=y
CONFIG_FUEL_GAUGE=y
CONFIG_NRF_FUEL_GAUGE=y
CONFIG_NRF_FUEL_GAUGE_VARIANT_SECONDARY_CELL=y

CONFIG_DISPLAY=y
CONFIG_SH8601=y

CONFIG_INPUT_GPIO_KEYS=y

CONFIG_LED=n
CONFIG_REBOOT=y
CONFIG_PWM=n

# Filesystem & Internal Flash support to store data
CONFIG_FLASH=y
CONFIG_FLASH_MAP=y
CONFIG_FLASH_PAGE_LAYOUT=y
CONFIG_FILE_SYSTEM=y
CONFIG_FILE_SYSTEM_LITTLEFS=y
CONFIG_MPU_ALLOW_FLASH_WRITE=y

# Enabled settings module and FS to store settings
CONFIG_SETTINGS=y
CONFIG_SETTINGS_RUNTIME=y
CONFIG_SETTINGS_FILE=y
CONFIG_SETTINGS_FILE_PATH="/lfs/sys/settings"

CONFIG_NVS=y

# LVGL Library Options - Debug configuration
CONFIG_LVGL=y
CONFIG_LV_COLOR_DEPTH_16=y
CONFIG_LV_COLOR_16_SWAP=y
CONFIG_LV_THEME_DEFAULT_DARK=y
CONFIG_LV_Z_MEM_POOL_SYS_HEAP=y
# Restored LVGL Memory Configuration for debugging
CONFIG_LV_Z_MEM_POOL_SIZE=24576         
#CONFIG_LV_MEM_CUSTOM=y
CONFIG_LV_Z_POINTER_INPUT_MSGQ_COUNT=50
CONFIG_LV_Z_POINTER_INPUT=y
#CONFIG_LV_DISP_DEF_REFR_PERIOD=30

# LVGL Font Options - Reduced font set to save flash
#CONFIG_LV_FONT_MONTSERRAT_12=y
#CONFIG_LV_FONT_MONTSERRAT_14=y
#CONFIG_LV_FONT_MONTSERRAT_16=y
CONFIG_LV_FONT_MONTSERRAT_20=y
CONFIG_LV_FONT_MONTSERRAT_24=y
#CONFIG_LV_FONT_MONTSERRAT_28=y
#CONFIG_LV_FONT_MONTSERRAT_34=y
#CONFIG_LV_FONT_MONTSERRAT_42=y
#CONFIG_LV_FONT_MONTSERRAT_48=y
#CONFIG_LV_FONT_MONTSERRAT_12_SUBPX=y
CONFIG_LV_FONT_DEFAULT_MONTSERRAT_24=y
#CONFIG_LV_USE_FONT_SUBPX=y

CONFIG_LV_USE_LABEL=y
CONFIG_LV_USE_MSGBOX=y
CONFIG_LV_USE_CHART=y
CONFIG_LV_USE_ROLLER=y
CONFIG_LV_USE_BUTTONMATRIX=y
CONFIG_LV_USE_SPINNER=y

CONFIG_LV_USE_CALENDAR=n
CONFIG_LV_USE_CHECKBOX=n
CONFIG_LV_USE_DROPDOWN=n
CONFIG_LV_USE_IMAGEBUTTON=n
CONFIG_LV_USE_KEYBOARD=n
CONFIG_LV_USE_LIST=n
CONFIG_LV_USE_MENU=n
CONFIG_LV_USE_LOTTIE=n
CONFIG_LV_USE_CANVAS=n
CONFIG_LV_USE_ANIMIMG=n
CONFIG_LV_USE_LED=n
CONFIG_LV_USE_LINE=n
CONFIG_LV_USE_SCALE=n
CONFIG_LV_USE_SPINBOX=n
CONFIG_LV_USE_TABLE=n
CONFIG_LV_USE_TABVIEW=n
CONFIG_LV_USE_TILEVIEW=n
CONFIG_LV_USE_WIN=n

# USB Configuration
CONFIG_USB_DEVICE_STACK=y
CONFIG_USB_DEVICE_PRODUCT="healthypi move"
CONFIG_USB_DEVICE_PID=0x0001
CONFIG_USB_DEVICE_VID=0x4440
CONFIG_USB_DEVICE_INITIALIZE_AT_BOOT=n

# Enable the serial MCUmgr transport.
CONFIG_BASE64=y
#CONFIG_MCUMGR_TRANSPORT_UART=y
CONFIG_NORDIC_QSPI_NOR=y
CONFIG_NORDIC_QSPI_NOR_FLASH_LAYOUT_PAGE_SIZE=4096
CONFIG_NORDIC_QSPI_NOR_STACK_WRITE_BUFFER_SIZE=16

CONFIG_PM_PARTITION_REGION_LITTLEFS_EXTERNAL=y
CONFIG_PM_PARTITION_SIZE_LITTLEFS=0x200000
CONFIG_PM_EXTERNAL_FLASH_MCUBOOT_SECONDARY=y

CONFIG_REQUIRES_FULL_LIBC=y
CONFIG_CMSIS_DSP=y
CONFIG_CMSIS_DSP_FILTERING=y

CONFIG_PM=y
CONFIG_PM_DEVICE=y
#CONFIG_PM_DEVICE_RUNTIME=y

# Enable the poweroff command (for power profiling)
CONFIG_POWEROFF=y

CONFIG_ZBUS=y

# Bootloader Configuration
CONFIG_BOOTLOADER_MCUBOOT=y
#CONFIG_SECURE_BOOT=y

# Enable MCUmgr and dependencies.

CONFIG_FLASH=y

CONFIG_MCUMGR=y
CONFIG_IMG_MANAGER=y
CONFIG_MCUMGR_GRP_IMG=y
CONFIG_MCUMGR_GRP_OS=y
CONFIG_MCUMGR_GRP_FS=y

CONFIG_NET_BUF=y
CONFIG_ZCBOR=y
CONFIG_CRC=y
CONFIG_MCUMGR=y
CONFIG_STREAM_FLASH=y
CONFIG_FLASH_MAP=y

CONFIG_MCUMGR_TRANSPORT_BT_REASSEMBLY=y
CONFIG_MCUMGR_TRANSPORT_NETBUF_SIZE=1024
CONFIG_MCUMGR_GRP_OS_MCUMGR_PARAMS=y
# Increased from 2048 to 4096 to prevent stack overflow during file downloads via SMP
# File system operations + CBOR encoding + network buffers require more stack space
CONFIG_MCUMGR_TRANSPORT_WORKQUEUE_STACK_SIZE=4096

CONFIG_MCUMGR_MGMT_NOTIFICATION_HOOKS=y
CONFIG_MCUMGR_GRP_IMG_UPLOAD_CHECK_HOOK=y
CONFIG_MCUMGR_GRP_IMG_STATUS_HOOKS=y

CONFIG_NCS_SAMPLE_MCUMGR_BT_OTA_DFU=y
CONFIG_NCS_SAMPLE_MCUMGR_BT_OTA_DFU_SPEEDUP=y


CONFIG_NCS_APPLICATION_BOOT_BANNER_STRING="HealthyPi Move"

# Debug logging options - Re-enabled for debugging
CONFIG_SERIAL=y
CONFIG_LOG=y
CONFIG_CONSOLE=y 
CONFIG_UART_CONSOLE=y

CONFIG_USE_SEGGER_RTT=y
CONFIG_SHELL_BACKEND_RTT=n
CONFIG_LOG_BACKEND_RTT=y
CONFIG_RTT_CONSOLE=y
CONFIG_SEGGER_RTT_BUFFER_SIZE_UP=4096

# Enable individual sensor logging for debugging
CONFIG_SENSOR_LOG_LEVEL_INF=y
CONFIG_LV_USE_LOG=n
CONFIG_LV_LOG_LEVEL_WARN=y
CONFIG_DISPLAY_LOG_LEVEL_ERR=y
CONFIG_INPUT_LOG_LEVEL_ERR=y

#Setup individual log levels for each sensor - enabled for debugging
CONFIG_MAX32664C_LOG_LEVEL_INF=y
CONFIG_MAX32664D_LOG_LEVEL_INF=y
CONFIG_BMI323_HPI_LOG_LEVEL_INF=y
CONFIG_MAX30001_LOG_LEVEL_INF=y

CONFIG_MAX32664_UPDATER=y
CONFIG_MAX32664_UPDATER_LOG_LEVEL_ERR=y

# Init changes for QSPI XIP code placement
#CONFIG_CUSTOM_LINKER_SCRIPT="linker_arm_extxip.ld"
#CONFIG_FLASH_INIT_PRIORITY=40
#CONFIG_SHELL_BACKEND_SERIAL_INIT_PRIORITY=50
#CONFIG_CODE_DATA_RELOCATION=y
#CONFIG_NORDIC_QSPI_NOR_XIP=y

# Configure Bluetooth Security Manager
CONFIG_BT_SMP=y
CONFIG_BT_SIGNING=y
CONFIG_BT_BONDABLE=y

CONFIG_BT_KEYS_OVERWRITE_OLDEST=y
CONFIG_BT_MAX_PAIRED=2
CONFIG_BT_SETTINGS=y


# CONFIG_LOG=y
# CONFIG_LOG_MODE_DEFERRED=y
# CONFIG_CBPRINTF_FP_SUPPORT=y
# CONFIG_NEWLIB_LIBC=y
# CONFIG_NEWLIB_LIBC_FLOAT_PRINTF=y

# CONFIG_CBPRINTF_COMPLETE=y


# Enable full libc with float printf support
CONFIG_CBPRINTF_FP_SUPPORT=y
CONFIG_CBPRINTF_COMPLETE=y  

# CONFIG_MINIMAL_LIBC=y
CONFIG_CMSIS_DSP=y
CONFIG_CMSIS_DSP_TRANSFORM=y
CONFIG_CMSIS_DSP_SUPPORT=y
CONFIG_CMSIS_DSP_FASTMATH=y
```

## src/hpi_common_types.h
```c
/*
 * HealthyPi Move
 * 
 * SPDX-License-Identifier: MIT
 *
 * Copyright (c) 2025 Protocentral Electronics
 *
 * Author: Ashwin Whitchurch, Protocentral Electronics
 * Contact: ashwin@protocentral.com
 *
 * Permission is hereby granted, free of charge, to any person obtaining a copy
 * of this software and associated documentation files (the "Software"), to deal
 * in the Software without restriction, including without limitation the rights
 * to use, copy, modify, merge, publish, distribute, sublicense, and/or sell
 * copies of the Software, and to permit persons to whom the Software is
 * furnished to do so, subject to the following conditions:
 *
 * The above copyright notice and this permission notice shall be included in all
 * copies or substantial portions of the Software.
 *
 * THE SOFTWARE IS PROVIDED "AS IS", WITHOUT WARRANTY OF ANY KIND, EXPRESS OR
 * IMPLIED, INCLUDING BUT NOT LIMITED TO THE WARRANTIES OF MERCHANTABILITY,
 * FITNESS FOR A PARTICULAR PURPOSE AND NONINFRINGEMENT. IN NO EVENT SHALL THE
 * AUTHORS OR COPYRIGHT HOLDERS BE LIABLE FOR ANY CLAIM, DAMAGES OR OTHER
 * LIABILITY, WHETHER IN AN ACTION OF CONTRACT, TORT OR OTHERWISE, ARISING FROM,
 * OUT OF OR IN CONNECTION WITH THE SOFTWARE OR THE USE OR OTHER DEALINGS IN THE
 * SOFTWARE.
 */


/*
HealthyPi specific common data types
*/

#pragma once

#include <time.h>

#define ECG_POINTS_PER_SAMPLE 16
#define BIOZ_POINTS_PER_SAMPLE 8
#define PPG_POINTS_PER_SAMPLE 8
#define BPT_PPG_POINTS_PER_SAMPLE 32

#define ECG_RECORD_BUFFER_SAMPLES 3840 // Full 30 seconds at 128 Hz (128*30) - 15.36KB total
#define GSR_RECORD_BUFFER_SAMPLES 960 // Full 30 seconds at 32 Hz (32*30) - 3.8KB total
#define BIOZ_MAX_SAMPLES 64    // safe for 32 Hz, 1–2 s batch

enum hpi_ppg_status 
{
    HPI_PPG_SCD_STATUS_UNKNOWN,
    HPI_PPG_SCD_OFF_SKIN,
    HPI_PPG_SCD_ON_OBJ,
    HPI_PPG_SCD_ON_SKIN,
};

struct hpi_ecg_bioz_sensor_data_t
{
    int32_t ecg_samples[ECG_POINTS_PER_SAMPLE];
    int32_t bioz_sample[BIOZ_POINTS_PER_SAMPLE];

    uint8_t ecg_num_samples;
    uint8_t bioz_num_samples;

    uint16_t rtor;
    uint16_t hr;
    uint8_t ecg_lead_off;
    uint8_t bioz_lead_off;
    bool _bioZSkipSample;

    uint8_t rrint;
};

struct hpi_gsr_sensor_data_t
{
    int32_t bioz_samples[BIOZ_POINTS_PER_SAMPLE];  // Conductance in µS × 100 (fixed-point from driver)
    uint8_t bioz_num_samples;                      // Number of valid samples in this batch
    uint8_t bioz_lead_off;                         // Lead-off detection status
};

/*
 * Lightweight BioZ-only sample used for internal producer/consumer queues
 * when ECG decoding is not required. Keeps the copy footprint small.
 *
 * Note: bioz_samples contains conductance values in µS × 100 (fixed-point).
 * The MAX30001 driver performs ADC-to-conductance conversion internally.
 */
struct hpi_bioz_sample_t
{
    int32_t bioz_samples[BIOZ_POINTS_PER_SAMPLE];  // Conductance in µS × 100 (fixed-point from driver)
    uint8_t bioz_num_samples;
    uint8_t bioz_lead_off;
    int64_t timestamp;
};

struct hpi_ppg_wr_data_t
{
    uint32_t raw_red[PPG_POINTS_PER_SAMPLE];
    uint32_t raw_ir[PPG_POINTS_PER_SAMPLE];
    uint32_t raw_green[PPG_POINTS_PER_SAMPLE];

    uint8_t ppg_num_samples;

    uint16_t hr;
    uint8_t hr_confidence;

    uint8_t spo2;
    uint8_t spo2_confidence;
    uint8_t spo2_valid_percent_complete;
	uint8_t spo2_state;
	uint8_t spo2_excessive_motion;
	uint8_t spo2_low_pi;

    uint8_t bp_sys;
    uint8_t bp_dia;
    uint8_t bpt_status;
    uint8_t bpt_progress;

    uint16_t rtor;
    uint8_t rtor_confidence;
    
    uint8_t scd_state;
};

struct hpi_ppg_fi_data_t
{
    uint32_t raw_red[BPT_PPG_POINTS_PER_SAMPLE];
    uint32_t raw_ir[BPT_PPG_POINTS_PER_SAMPLE];

    uint8_t ppg_num_samples;

    uint16_t hr;
    uint8_t hr_confidence;

    uint8_t spo2;
    uint8_t spo2_confidence;
    uint8_t spo2_valid_percent_complete;
    uint8_t spo2_state;

    uint8_t bp_sys;
    uint8_t bp_dia;
    uint8_t bpt_status;
    uint8_t bpt_progress;

    uint16_t rtor;
    uint8_t rtor_confidence;
    
    uint8_t scd_state;
};

/*struct hpi_ppg_fi_bpt_cal_t
{
    uint32_t 
}*/

struct hpi_computed_hrv_t
{
    int32_t hrv_max;
    int32_t hrv_min;
    float mean;
    float sdnn;
    float pnn;
    float rmssd;
    bool hrv_ready_flag;
};

struct hpi_hr_t
{
    int64_t timestamp;
    uint16_t hr;
    bool hr_ready_flag;
};

struct hpi_steps_t
{
    int64_t timestamp;
    uint16_t steps;
};

struct hpi_temp_t
{
    int64_t timestamp;
    double temp_f;
    double temp_c;
};

struct hpi_bpt_t
{
    int64_t timestamp;

    uint16_t sys;
    uint16_t dia;
    uint16_t hr;

    uint8_t spo2;
    uint8_t spo2_conf;
    uint8_t spo2_report;

    uint8_t status;
    uint8_t progress;
};

struct hpi_bpt_point_t
{ 
    int64_t timestamp;

    uint16_t sys;
    uint16_t dia;
    uint16_t hr;
};

struct hpi_spo2_point_t
{
    int64_t timestamp;
    uint16_t spo2;
};

struct hpi_batt_status_t
{
    uint8_t batt_level;
    bool batt_charging;
};

enum hpi_ecg_status
{
    HPI_ECG_STATUS_IDLE = 0x00,
    HPI_ECG_STATUS_STREAMING,
    HPI_ECG_STATUS_COMPLETE,
    HPI_ECG_STATUS_ERROR,
};

enum hpi_ble_event
{
    HPI_BLE_EVENT_PAIR_REQUEST =0x01,
    HPI_BLE_EVENT_PAIR_SUCCESS,
    HPI_BLE_EVENT_PAIR_FAILED,
    HPI_BLE_EVENT_PAIR_CANCELLED,
};

enum hpi_bpt_status
{
    HPI_BPT_STATUS_IDLE = 0x00,
    HPI_BPT_STATUS_MEASURING,
    HPI_BPT_STATUS_COMPLETE,
    HPI_BPT_STATUS_ERROR,
    HPI_BPT_STATUS_CANCELLED,
    HPI_BPT_STATUS_TIMEOUT,
};

struct hpi_ecg_status_t
{
    int64_t ts_complete;
    uint8_t status;
    uint16_t progress_timer;
    uint8_t hr;
};

struct hpi_ecg_lead_on_off_t
{
    bool lead_on_off;
};

enum spo2_meas_state
{
    SPO2_MEAS_LED_ADJ = 0x00,
    SPO2_MEAS_COMPUTATION,
    SPO2_MEAS_SUCCESS,
    SPO2_MEAS_TIMEOUT,
    SPO2_MEAS_UNK,
};

enum spo2_source
{
    SPO2_SOURCE_PPG_WR = 0x00,
    SPO2_SOURCE_PPG_FI,
};

struct hpi_version_desc_t
{
    uint8_t major;
    uint8_t minor;
    uint8_t patch;
};

struct hpi_last_update_time_t
{
    uint16_t hr_last_value;
    int64_t hr_last_update_ts;

    uint8_t spo2_last_value;
    int64_t spo2_last_update_ts;
    
    uint8_t bp_sys_last_value;
    uint8_t bp_dia_last_value;
    int64_t bp_last_update_ts;

    uint8_t ecg_last_hr;
    int64_t ecg_last_update_ts;

    uint16_t steps_last_value;
    int64_t steps_last_update_ts;

    uint16_t temp_last_value;
    int64_t temp_last_update_ts;

    uint16_t gsr_last_value; // GSR value * 100 (microsiemens) - legacy, use stress_* fields
    int64_t gsr_last_update_ts;

    // GSR Stress Index fields
    uint8_t gsr_stress_level;           // 0-100 stress score
    uint16_t gsr_tonic_level_x100;      // SCL in μS * 100
    uint8_t gsr_peaks_per_minute;       // SCR rate

    uint16_t hrv_lf_hf_ratio_x100;  // LF/HF ratio * 100
    uint16_t hrv_sdnn_x10;          // SDNN in ms * 10
    uint16_t hrv_rmssd_x10;         // RMSSD in ms * 10
    int64_t hrv_last_update_ts;
};

struct hpi_gsr_stress_index_t
{
    uint8_t stress_level;              // 0-100 stress score
    uint16_t tonic_level_x100;         // Baseline GSR (SCL) in μS * 100
    uint16_t phasic_amplitude_x100;    // Current phasic response (SCR) in μS * 100
    uint8_t peaks_per_minute;          // Number of SCR peaks detected per minute
    uint16_t mean_peak_amplitude_x100; // Average peak amplitude in μS * 100
    int64_t last_peak_timestamp;       // Timestamp of last detected peak
    bool stress_data_ready;            // Flag indicating valid stress data
};

// Live GSR measurement status (mirrors ECG status concept for timers)
struct hpi_gsr_status_t
{
    uint16_t elapsed_s;    // Seconds since measurement start
    uint16_t remaining_s;  // Seconds remaining to target duration (0 when complete)
    uint16_t total_s;      // Total target duration (e.g. 60)
    bool active;           // Measurement currently active
};

// HRV (Heart Rate Variability) evaluation - stores R-to-R intervals for analysis
#define HRV_MAX_INTERVALS 300  // Maximum R-to-R intervals to store (typically ~5 minutes @ ~60 bpm)

struct hpi_hrv_interval_t
{
    uint16_t rtor_ms;      // R-to-R interval in milliseconds
    int64_t timestamp;     // Timestamp when interval was captured
};

// HRV evaluation results
struct hpi_hrv_eval_result_t
{
    uint16_t num_intervals;           // Number of R-to-R intervals captured
    uint32_t total_duration_ms;       // Total duration in milliseconds
    uint16_t min_interval_ms;         // Minimum R-to-R interval
    uint16_t max_interval_ms;         // Maximum R-to-R interval
    float mean_interval_ms;           // Mean R-to-R interval
    float sdnn_ms;                    // Standard deviation of R-to-R intervals (HRV indicator)
    float pnn50_percent;              // Percentage of intervals differing > 50ms (HRV indicator)
    float rmssd_ms;                   // Root mean square of successive differences (HRV indicator)
    int64_t measurement_start_ts;     // Unix timestamp when measurement started
    int64_t measurement_complete_ts;  // Unix timestamp when measurement completed
};

struct hpi_hrv_status_t
{
    uint16_t elapsed_s;         // Seconds since measurement start
    uint16_t remaining_s;       // Seconds remaining to target duration
    uint16_t total_s;           // Total target duration
    bool active;        // Current HRV measurement status
};

/* Published by haptic_module when combined stress trigger fires */
struct hpi_haptic_alert_t {
    uint8_t  sensors_triggered; /* bitmask: bit0=HR, bit1=GSR, bit2=HRV */
    uint8_t  count;             /* number of sensors that triggered (2 or 3) */
};

/* Published by haptic_module after each RMSSD computation */
struct hpi_haptic_hrv_t {
    uint32_t rmssd;          /* current RMSSD in ms */
    int32_t  baseline;       /* current RMSSD baseline in ms */
    int32_t  threshold;      /* stress threshold (baseline × drop%) in ms */
    bool     stressed;       /* current HRV stress state */
    uint16_t rr_buf[60];     /* RR interval history (oldest to newest, ms) */
    uint8_t  rr_count;       /* valid entries in rr_buf */
};

/* Published by haptic_module after each HR sample (post-warmup) */
struct hpi_haptic_hr_t {
    uint16_t hr;             /* current heart rate in BPM */
    int32_t  baseline;       /* current HR baseline in BPM */
    int32_t  threshold;      /* stress threshold (baseline + rise%) in BPM */
    bool     stressed;       /* current HR stress state */
};

/* Published by haptic_module after each processed GSR batch */
struct hpi_haptic_gsr_t {
    int32_t  ema;            /* current EMA (µS × 100) */
    int32_t  baseline;       /* current baseline (µS × 100) */
    int32_t  threshold;      /* current stress threshold (µS × 100) */
    bool     stressed;       /* current GSR stress state */
    int32_t  ema_buf[60];    /* EMA history (oldest to newest, µS × 100) */
    uint8_t  buf_count;      /* valid entries in ema_buf */
};
```

## src/hpi_zbus_channels.c
```c
/*
 * HealthyPi Move
 * 
 * SPDX-License-Identifier: MIT
 *
 * Copyright (c) 2025 Protocentral Electronics
 *
 * Author: Ashwin Whitchurch, Protocentral Electronics
 * Contact: ashwin@protocentral.com
 *
 * Permission is hereby granted, free of charge, to any person obtaining a copy
 * of this software and associated documentation files (the "Software"), to deal
 * in the Software without restriction, including without limitation the rights
 * to use, copy, modify, merge, publish, distribute, sublicense, and/or sell
 * copies of the Software, and to permit persons to whom the Software is
 * furnished to do so, subject to the following conditions:
 *
 * The above copyright notice and this permission notice shall be included in all
 * copies or substantial portions of the Software.
 *
 * THE SOFTWARE IS PROVIDED "AS IS", WITHOUT WARRANTY OF ANY KIND, EXPRESS OR
 * IMPLIED, INCLUDING BUT NOT LIMITED TO THE WARRANTIES OF MERCHANTABILITY,
 * FITNESS FOR A PARTICULAR PURPOSE AND NONINFRINGEMENT. IN NO EVENT SHALL THE
 * AUTHORS OR COPYRIGHT HOLDERS BE LIABLE FOR ANY CLAIM, DAMAGES OR OTHER
 * LIABILITY, WHETHER IN AN ACTION OF CONTRACT, TORT OR OTHERWISE, ARISING FROM,
 * OUT OF OR IN CONNECTION WITH THE SOFTWARE OR THE USE OR OTHER DEALINGS IN THE
 * SOFTWARE.
 */


#include <zephyr/kernel.h>
#include <zephyr/zbus/zbus.h>
#include <zephyr/drivers/rtc.h>

#include <time.h>

#include "hw_module.h"
#include "hpi_common_types.h"
#include "recording_module.h"

ZBUS_CHAN_DEFINE(batt_chan,                     /* Name */
                 struct hpi_batt_status_t,      /* Message type */
                 NULL,                          /* Validator */
                 NULL,                          /* User Data */
                 ZBUS_OBSERVERS(disp_batt_lis), /* observers */
                 ZBUS_MSG_INIT(0)               /* Initial value {0} */
);

ZBUS_CHAN_DEFINE(sys_time_chan, /* Name */
                 struct tm,     /* Message type */
                 NULL,          /* Validator */
                 NULL,          /* User Data */
                 ZBUS_OBSERVERS(disp_sys_time_lis, trend_sys_time_lis, sys_sys_time_lis),
                 ZBUS_MSG_INIT(0) /* Initial value {0} */
);

ZBUS_CHAN_DEFINE(hr_chan,         /* Name */
                 struct hpi_hr_t, /* Message type */
                 NULL,            /* Validator */
                 NULL,            /* User Data */
                 ZBUS_OBSERVERS(disp_hr_lis, trend_hr_lis, sys_hr_lis, haptic_hr_lis),
                 ZBUS_MSG_INIT(0) /* Initial value {0} */
);

ZBUS_CHAN_DEFINE(steps_chan,         /* Name */
                 struct hpi_steps_t, /* Message type */
                 NULL,               /* Validator */
                 NULL,               /* User Data */
                 ZBUS_OBSERVERS(disp_steps_lis, trend_steps_lis, sys_steps_lis),
                 ZBUS_MSG_INIT(0) /* Initial value {0} */
);

ZBUS_CHAN_DEFINE(temp_chan, /* Name */
                 struct hpi_temp_t,
                 NULL, /* Validator */
                 NULL, /* User Data */
                 ZBUS_OBSERVERS(disp_temp_lis, trend_temp_lis, sys_temp_lis),
                 ZBUS_MSG_INIT(0) /* Initial value {0} */
);

ZBUS_CHAN_DEFINE(bpt_chan, /* Name */
                 struct hpi_bpt_t,
                 NULL, /* Validator */
                 NULL, /* User Data */
                 ZBUS_OBSERVERS(disp_bpt_lis, trend_bpt_lis, ble_bpt_lis, sys_bpt_lis),
                 ZBUS_MSG_INIT(0) /* Initial value {0} */
);

ZBUS_CHAN_DEFINE(spo2_chan, /* Name */
                 struct hpi_spo2_point_t,
                 NULL, /* Validator */
                 NULL, /* User Data */
                 ZBUS_OBSERVERS(disp_spo2_lis, trend_spo2_lis),
                 ZBUS_MSG_INIT(0) /* Initial value {0} */
);

ZBUS_CHAN_DEFINE(ecg_stat_chan, /* Name */
                 struct hpi_ecg_status_t,
                 NULL, /* Validator */
                 NULL, /* User Data */
                 ZBUS_OBSERVERS(disp_ecg_stat_lis, sys_ecg_stat_lis),
                 ZBUS_MSG_INIT(0) /* Initial value {0} */
);

ZBUS_CHAN_DEFINE(hrv_stat_chan, /* Name */
                 struct hpi_hrv_status_t,
                 NULL, /* Validator */
                 NULL, /* User Data */
                 ZBUS_OBSERVERS(disp_hrv_stat_lis, sys_hrv_stat_lis),
                 ZBUS_MSG_INIT(0) /* Initial value {0} */
);

#if defined(CONFIG_HPI_GSR_STRESS_INDEX)
ZBUS_CHAN_DEFINE(gsr_stress_chan, /* Name */
                 struct hpi_gsr_stress_index_t,
                 NULL, /* Validator */
                 NULL, /* User Data */
                 ZBUS_OBSERVERS(disp_gsr_stress_lis),
                 ZBUS_MSG_INIT(0) /* Initial value {0} */
);
#endif

#if defined(CONFIG_HPI_GSR_SCREEN)
// Live GSR status channel (elapsed/remaining time updates)
ZBUS_CHAN_DEFINE(gsr_status_chan,
                 struct hpi_gsr_status_t,
                 NULL,
                 NULL,
                 ZBUS_OBSERVERS(disp_gsr_status_lis),
                 ZBUS_MSG_INIT(0));
#endif

// Recording status channel (for UI updates during background recording)
ZBUS_CHAN_DEFINE(recording_status_chan,
                 struct hpi_recording_status_t,
                 NULL,
                 NULL,
                 ZBUS_OBSERVERS(disp_recording_lis),
                 ZBUS_MSG_INIT(0));

// Haptic module → display channels (stress detection results)
ZBUS_CHAN_DEFINE(haptic_alert_chan,
                 struct hpi_haptic_alert_t,
                 NULL,
                 NULL,
                 ZBUS_OBSERVERS(disp_haptic_alert_lis),
                 ZBUS_MSG_INIT(0));

ZBUS_CHAN_DEFINE(haptic_hrv_chan,
                 struct hpi_haptic_hrv_t,
                 NULL,
                 NULL,
                 ZBUS_OBSERVERS(disp_haptic_hrv_lis),
                 ZBUS_MSG_INIT(0));

ZBUS_CHAN_DEFINE(haptic_gsr_chan,
                 struct hpi_haptic_gsr_t,
                 NULL,
                 NULL,
                 ZBUS_OBSERVERS(disp_haptic_gsr_lis),
                 ZBUS_MSG_INIT(0));

ZBUS_CHAN_DEFINE(haptic_hr_chan,
                 struct hpi_haptic_hr_t,
                 NULL,
                 NULL,
                 ZBUS_OBSERVERS(disp_haptic_hr_lis),
                 ZBUS_MSG_INIT(0));
```
